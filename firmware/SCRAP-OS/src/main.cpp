#include <Arduino.h>
#include <driver/spi_master.h>
#include <span>
#include <vector>
#include <array>

#define DEFAULT_FACE_HEIGHT 32
#define DEFAULT_FACE_WIDTH 128

// array size is 12288
const int default_face[] PROGMEM = {
  0x000000, 0x000000, 0x000000, 0x000000, 0x000000, 0x000000, 0x000000, 0x000000, 0x000000, 0x000000, 0x000000, 0x000000,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 0x000000, 
  0x000000, 0x000000, 0x000000, 0x000000, 0x000000, 0x000000, 0x000000, 0x000000, 0x000000, 0x000000, 0x000000, 0x000000,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 0x000000, 
  0x000000, 0x000000, 0x000000, 0x000000, 0x000000, 0x000000, 0x000000, 0x000000, 0x000000, 0x000000, 0x000000, 0x000000,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 0x000000, 
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  0x000000, 0x000000, 0x000000, 0x000000, 0x000000, 0x000000, 0x000000, 0x000000, 0x000000, 0x000000, 0x000000, 0x000000,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 0x000000
};



float cycle = 0.0;
long last_frame = 0;
using Rgb = uint32_t;
class RP_HUB75
{
spi_device_handle_t halfDuplexDeviceHandle = nullptr;
private:
  uint8_t _width;
  uint8_t _height;
  uint8_t _cs;
  float _brightness;
  bool is_initialized = false;
  std::vector<uint8_t> frame;
  const std::array<uint8_t, 32> syncBuffer = {
    0x92, 0xac, 0xca, 0x3b, 0xbf, 0x41, 0x3d, 0x39, 0x4a, 0xa7, 0x01, 0xae, 0x5d, 0x15, 0x70, 0xfb,
    0x81, 0xf6, 0x6d, 0x2f, 0x31, 0x49, 0xa3, 0x0f, 0xbf, 0x77, 0x56, 0xd7, 0xf9, 0x26, 0xb6, 0x4e
  };
  std::array<uint8_t, 8> modesetBuffer;
  spi_host_device_t host = SPI2_HOST;
  spi_bus_config_t busConfig;
  spi_device_interface_config_t devConfig;

  void createModesetBuffer() {
    // copied the format over from the original driver code:
    modesetBuffer[0] = 0xfb;
    modesetBuffer[1] = 0x00;
    modesetBuffer[2] = 0x09;
    modesetBuffer[3] = static_cast<uint8_t>(255.0f * _brightness);
    modesetBuffer[4] = static_cast<uint8_t>(_width & 0xFF);
    modesetBuffer[5] = static_cast<uint8_t>((_width >> 8) & 0xFF);
    modesetBuffer[6] = 0x00;
    modesetBuffer[7] = 0x00;
  }

  void setPixelByIndex(size_t i, uint8_t r, uint8_t g, uint8_t b) {
    i *= 3;
    if (i + 2 < frame.size()) {
      frame[i]     = r;
      frame[i + 1] = g;
      frame[i + 2] = b;
    }
  }

public:
  RP_HUB75(uint16_t width, uint16_t height) 
    : _width(width), _height(height), _brightness(0.5f) 
  {
    frame.resize(_width * _height * 3, 0);
    createModesetBuffer();
  }

  ~RP_HUB75() {
    close();
  }


/// SETUP SPI/ SPI DATA functions

// void setupSPI(std::array<uint8_t,4> dataPins, uint8_t clk, uint8_t cs, int baud) {
//   _cs = cs;
//   busConfig = {
//     .data0_io_num = dataPins[0],
//     .data1_io_num = dataPins[1],
//     .sclk_io_num = clk,
//     .data2_io_num = dataPins[2],
//     .data3_io_num = dataPins[3],
//     .max_transfer_sz = 0,
//     .flags = SPICOMMON_BUSFLAG_QUAD,
//     .isr_cpu_id = ESP_INTR_CPU_AFFINITY_AUTO,
//     .intr_flags = 0
//   };
//   esp_err_t error = spi_bus_initialize(host, &busConfig, SPI_DMA_CH_AUTO);
//   if ( error != ESP_OK) {
//     Serial.println(esp_err_to_name(error));
//   }
//   devConfig = {
//     .command_bits = 0,
//     .address_bits = 0,
//     .dummy_bits = 0,
//     .mode = 0,
//     .clock_source = SPI_CLK_SRC_DEFAULT,
//     .duty_cycle_pos = 0,
//     .cs_ena_pretrans = 0,
//     .cs_ena_posttrans = 0,
//     .clock_speed_hz = baud,
//     .input_delay_ns = 0,
//     .spics_io_num = -1,
//     .flags = SPI_DEVICE_TXBIT_LSBFIRST | SPI_DEVICE_RXBIT_LSBFIRST,
//     .queue_size = 1,
//     .pre_cb = nullptr,
//     .post_cb = nullptr,
//   };
//   devConfig.flags |= SPI_DEVICE_HALFDUPLEX;
//   error = spi_bus_add_device(host, &devConfig, &halfDuplexDeviceHandle);
//   if (error != ESP_OK) {
//     spi_bus_free(host);
//     Serial.println(esp_err_to_name(error));
//   }

// }
void setupSPI(std::array<uint8_t,4> dataPins, uint8_t clk, uint8_t cs, int baud) {
  _cs = cs;
  
  int max_buffer_size = static_cast<int>(_width * _height * 3) + 64;

  busConfig = {
    .data0_io_num = dataPins[0],
    .data1_io_num = dataPins[1],
    .sclk_io_num = clk,
    .data2_io_num = dataPins[2],
    .data3_io_num = dataPins[3],
    .max_transfer_sz = max_buffer_size,
    .flags = SPICOMMON_BUSFLAG_QUAD,
    .isr_cpu_id = ESP_INTR_CPU_AFFINITY_AUTO,
    .intr_flags = 0
  };
  
  esp_err_t error = spi_bus_initialize(host, &busConfig, SPI_DMA_CH_AUTO);
  if (error != ESP_OK) {
    Serial.println(esp_err_to_name(error));
  }
  
  devConfig = {
    .command_bits = 0,
    .address_bits = 0,
    .dummy_bits = 0,
    .mode = 0,
    .clock_source = SPI_CLK_SRC_DEFAULT,
    .duty_cycle_pos = 0,
    .cs_ena_pretrans = 0,
    .cs_ena_posttrans = 0,
    .clock_speed_hz = baud,
    .input_delay_ns = 0,
    .spics_io_num = -1,
    .flags = SPI_DEVICE_TXBIT_LSBFIRST | SPI_DEVICE_RXBIT_LSBFIRST,
    .queue_size = 1,
    .pre_cb = nullptr,
    .post_cb = nullptr,
  };
  devConfig.flags |= SPI_DEVICE_HALFDUPLEX;
  
  error = spi_bus_add_device(host, &devConfig, &halfDuplexDeviceHandle);
  if (error != ESP_OK) {
    spi_bus_free(host);
    Serial.println(esp_err_to_name(error));
  }
}
void close() {
    if (open) {
        spi_bus_remove_device(halfDuplexDeviceHandle);
        spi_bus_free(host);
    }


}

void sendData(std::span<const uint8_t> data) {
  gpio_set_direction(static_cast<gpio_num_t>(_cs), GPIO_MODE_OUTPUT);
  gpio_set_level(static_cast<gpio_num_t>(_cs), 0);
  spi_transaction_t transaction = {
    .flags = SPI_TRANS_MODE_QIO,
    .cmd = 0,
    .addr = 0,
    .length = data.size() * 8,
    .rxlength = 0,
    .user = nullptr,
    .tx_buffer = data.data(),
    .rx_buffer = nullptr,
  };
  esp_err_t err = spi_device_transmit(halfDuplexDeviceHandle, &transaction);
  if (err != ESP_OK) {
    Serial.println(esp_err_to_name(err));
  }
  gpio_set_level(static_cast<gpio_num_t>(_cs), 1);
}

//////// DISPLAY DRIVER FUNCTIONS


  void setPixel(int16_t x, int16_t y, Rgb color) {
    if (x < 0 || x >= _width || y < 0 || y >= _height) return;
    
    size_t i = x + _width * y;
    uint8_t r = (color & 0xff0000) >> 16;
    uint8_t g = (color & 0x00ff00) >> 8;
    uint8_t b = color & 0x0000ff;

    setPixelByIndex(i, r, g, b);
  }

  void clear() {
    std::fill(frame.begin(), frame.end(), 0);
  }

  void fill(Rgb color) {
    uint8_t r = (color & 0xff0000) >> 16;
    uint8_t g = (color & 0x00ff00) >> 8;
    uint8_t b = color & 0x0000ff;

    for (size_t i = 0; i < frame.size() / 3; i++) {
      setPixelByIndex(i, r, g, b);
    }
  }

  void setBrightness(float value) {
    if (value < 0.0f) value = 0.0f;
    if (value > 1.0f) value = 1.0f;
    _brightness = value;
    createModesetBuffer();
  }

  void show() {
    sendData(syncBuffer);

    sendData(modesetBuffer);
    
    sendData(frame);
  }

};
std::array<uint8_t,4> dataPins = {38,39,41,45};
RP_HUB75 display(128, 32);

void setup() {
  Serial.begin(115200);
  delay(1000);
  display.setupSPI(dataPins, 3, 1, 20000000); 
  display.setBrightness(1);
  display.clear();
  display.fill(0x0000FF);
  display.show();
  int i = 0;
  for(int y= 0; y <32;y++) {

    for(int x = 0; x <128; x++){
      
      display.setPixel(x,y,default_face[i]);
      i++;
      //delay(1);
    }
  }
  display.show();
  // display.setPixel(0,0,0xFF0000);
  // display.setPixel(0,31,0xFF0000);
  // display.show();
  delay(1000);

}

void loop() {
  // if((last_frame - millis()) > 8) {
  //   last_frame = millis();
  //   display.clear();
  // display.setPixel(20+10*sin(cycle/5),16,0x55055);
  
  // display.show();
  // delay(16);
  // cycle++;
  // }
  
  // put your main code here, to run repeatedly:
}
